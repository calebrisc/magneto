## firmware/m1_logger/build/m1_logger/Kconfig/boards/Kconfig.defconfig
```kconfig
# Load Zephyr board defconfig descriptions.
osource "/opt/nordic/ncs/v3.4.0/zephyr/boards/nordic/nrf54l15dk/Kconfig.defconfig"
```

## firmware/m1_logger/build/m1_logger/Kconfig/boards/Kconfig.nrf54l15dk.tmp
```kconfig
# Load board Kconfig descriptions.
osource "/opt/nordic/ncs/v3.4.0/zephyr/boards/nordic/nrf54l15dk/Kconfig.nrf54l15dk"
```
